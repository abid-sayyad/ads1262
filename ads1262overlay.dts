/dts-v1/;
/plugin/;
/ {
	compatible = "raspberrypi,model-zero-2", "brcm,bcm2710";
	fragment@0 {
		target = <&spidev0>;
		__overlay__ {
			status = "disabled";
		};
	};
		
	fragment@1 {
		target = <&spi0>;
		__overlay__ {
			status = "okay";
			#address-cells = <1>;
			#size-cells = <0>;

			ads1262: ads1262@0 {
				compatible = "ti,ads1262";
				reg = <0x0>;
				spi-max-frequency = <7372800>;
				spi-bits-per-word = <8>;
				spi-cpha;
				status = "okay";
			};
		};
	};
};
